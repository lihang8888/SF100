## config/boards/shields/charybdis_cirque/Kconfig.defconfig
```kconfig
if SHIELD_SF100_LEFT_CENTRAL || SHIELD_SF100_DONGLE

    config ZMK_KEYBOARD_NAME
        default "SF100"
    
    config ZMK_SPLIT_ROLE_CENTRAL
        default y

endif

if SHIELD_SF100_LEFT || SHIELD_SF100_RIGHT || SHIELD_SF100_PAD || SHIELD_SF100_DONGLE || SHIELD_SF100_LEFT_CENTRAL

    config ZMK_SPLIT
        default y

endif
```

## config/boards/shields/charybdis_cirque/Kconfig.shield
```kconfig
config SHIELD_SF100_LEFT
    def_bool $(shields_list_contains,sf100_left)

config SHIELD_SF100_LEFT_CENTRAL
    def_bool $(shields_list_contains,sf100_left_central)

config SHIELD_SF100_RIGHT
    def_bool $(shields_list_contains,sf100_right)

config SHIELD_SF100_PAD
    def_bool $(shields_list_contains,sf100_pad)

config SHIELD_SF100_DONGLE
    def_bool $(shields_list_contains,sf100_dongle)
```
